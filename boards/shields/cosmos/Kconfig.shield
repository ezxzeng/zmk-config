## boards/shields/cosmos/Kconfig.shield
```kconfig
# Copyright (c) 2022 The ZMK Contributors
# SPDX-License-Identifier: MIT

config SHIELD_sweepsq_LEFT
    def_bool $(shields_list_contains,cosmos_left)

config SHIELD_sweepsq_RIGHT
    def_bool $(shields_list_contains,cosmos_right)

config SHIELD_sweepsq_DONGLE
    def_bool $(shields_list_contains,cosmos_dongle)
```

## boards/shields/sweepsq/Kconfig.shield
```kconfig
# Copyright (c) 2022 The ZMK Contributors
# SPDX-License-Identifier: MIT

config SHIELD_sweepsq_LEFT
    def_bool $(shields_list_contains,sweepsq_left)

config SHIELD_sweepsq_RIGHT
    def_bool $(shields_list_contains,sweepsq_right)
```

## config/boards/shields/cake_reddot/Kconfig.shield
```kconfig
# Copyright (c) 2020 Pete Johanson
# SPDX-License-Identifier: MIT

config SHIELD_CAKE_REDDOT_LEFT
    def_bool $(shields_list_contains,cake_reddot_left)

config SHIELD_CAKE_REDDOT_RIGHT
    def_bool $(shields_list_contains,cake_reddot_right)
```

## config/boards/shields/sweep_sq/Kconfig.defconfig
```kconfig
# Copyright (c) 2022 The ZMK Contributors
# SPDX-License-Identifier: MIT

if SHIELD_SWEEP_SQ_LEFT

config ZMK_KEYBOARD_NAME
    default "sweep_sq"

config ZMK_SPLIT_ROLE_CENTRAL
    default y

endif

if SHIELD_SWEEP_SQ_LEFT || SHIELD_SWEEP_SQ_RIGHT
config ZMK_SPLIT
    default y
endif
```

## config/boards/shields/sweep_sq/Kconfig.shield
```kconfig
# Copyright (c) 2022 The ZMK Contributors
# SPDX-License-Identifier: MIT

config SHIELD_SWEEP_SQ_LEFT
    def_bool $(shields_list_contains,sweep_sq_left)

config SHIELD_SWEEP_SQ_RIGHT
    def_bool $(shields_list_contains,sweep_sq_right)
```

## config/west.yml
```yaml
manifest:
  remotes:
    - name: zmkfirmware
      url-base: https://github.com/ezxzeng/     # <--- CHANGE REPO
  projects:
    - name: zmk
      remote: zmkfirmware
      revision: pointers_plus_split_battery                # <--- CHANGE REVISION
      import: app/west.yml
  self:
    path: config
```
