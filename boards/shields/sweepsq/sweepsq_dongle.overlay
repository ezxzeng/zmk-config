#include <dt-bindings/zmk/matrix_transform.h>
#include "sweepsq.dtsi"
#import "sweepsq-layouts.dtsi"


/ {
    chosen {
        zmk,kscan = &mock_kscan;
        zmk,physical-layout = &foostan_corne_5col_layout;
    };

    mock_kscan: mock_kscan_0 {
        compatible = "zmk,kscan-mock";
        columns = <0>;
        rows = <0>;
        events = <0>;
    };
};